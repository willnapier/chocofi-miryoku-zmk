#include <behaviors.dtsi>
#include <dt-bindings/zmk/keys.h>
#include <dt-bindings/zmk/bt.h>
#include "../miryoku/miryoku_babel/miryoku_layer_alternatives.h"
#include "../miryoku/miryoku_mousekeys.h"
#include "../miryoku/custom_config.h"
#include "../miryoku/mapping/36/corne.h"
#include "../miryoku/miryoku.dtsi"

/ {
    keymap {
        compatible = "zmk,keymap";
        default_layer {
            bindings = <
                MIRYOKU_ALTERNATIVES_BASE_COLEMAKDH
            >;
        };
        mouse_layer {
            bindings = <
                MIRYOKU_ALTERNATIVES_MOUSE
            >;
        };
    };
};
